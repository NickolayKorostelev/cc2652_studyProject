/**
 * @cliArgs --board "/ti/boards/CC26X2R1_LAUNCHXL" --product "simplelink_cc13x2_26x2_sdk@4.40.04.04"
 * @versions {"data":"2021010520","timestamp":"2021010520","tool":"1.7.0+1746","templates":null}
 */

/**
 * Import the modules used in this configuration.
 */
const GPIO    = scripting.addModule("/ti/drivers/GPIO");
const GPIO1   = GPIO.addInstance();
const I2C     = scripting.addModule("/ti/drivers/I2C", {}, false);
const I2C1    = I2C.addInstance();
const RTOS    = scripting.addModule("/ti/drivers/RTOS");
const Button  = scripting.addModule("/ti/drivers/apps/Button", {}, false);
const Button1 = Button.addInstance();

/**
 * Write custom configuration values to the imported modules.
 */
GPIO1.$hardware         = system.deviceData.board.components.LED_RED;
GPIO1.$name             = "CONFIG_GPIO_LED_0";
GPIO1.pinInstance.$name = "CONFIG_PIN_0";

I2C1.maxBitRate           = 400000;
I2C1.$name                = "TEST_I2C";
I2C1.sdaPinInstance.$name = "CONFIG_PIN_1";
I2C1.clkPinInstance.$name = "CONFIG_PIN_2";

const CCFG              = scripting.addModule("/ti/devices/CCFG", {}, false);
CCFG.ccfgTemplate.$name = "ti_devices_CCFGTemplate0";

Button1.$name                     = "CONFIG_BUTTON_0";
Button1.$hardware                 = system.deviceData.board.components["BTN-1"];
Button1.gpioPin.mode              = scripting.forceWrite("Input");
Button1.gpioPin.callbackFunction  = "bntConfigCallback";
Button1.gpioPin.$name             = "BTN_1";
Button1.gpioPin.pinInstance.$name = "CONFIG_PIN_3";

/**
 * Pinmux solution for unlocked pins/peripherals. This ensures that minor changes to the automatic solver in a future
 * version of the tool will not impact the pinmux you originally saw.  These lines can be completely deleted in order to
 * re-solve from scratch.
 */
GPIO1.gpioPin.$suggestSolution           = "boosterpack.39";
I2C1.i2c.$suggestSolution                = "I2C0";
I2C1.i2c.sdaPin.$suggestSolution         = "boosterpack.10";
I2C1.i2c.sclPin.$suggestSolution         = "boosterpack.9";
Button1.gpioPin.gpioPin.$suggestSolution = "boosterpack.13";
